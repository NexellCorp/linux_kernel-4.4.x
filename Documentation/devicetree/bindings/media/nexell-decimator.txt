## Documentation/devicetree/bindings/media/nexell-decimator.txt
```
Nexell V4L2 Device Tree bindings
================================

Decimator can scale down input image and saves to memory.
Normally this function is same to pip-preview function.

Required properties:
- compatible	: must contain "nexell,nx-decimator"
- module	: vip module number
- logical	: whether logical device or not (1 - logical, 0 or none - pysical)
		  logical device is not a real camera device
		  It's just for making a logical video device to use the decimator with another sensor.
- status	: to enable, must contain "okay"

Example:
	decimator {
		compatible = "nexell,nx-decimator";
		module = <1>;
		logical = <1>;
		status = "okay";
	};
```

## Documentation/devicetree/bindings/pinctrl/nexell,s5p6818-pinctrl.txt
```
Binding for Nexell s5p6818 pin cotroller
========================================

Nexell's ARM bases SoC's integrates a GPIO and Pin mux/config hardware
controller. It controls the input/output settings on the available pads/pins
and also provides ability to multiplex and configure the output of various
on-chip controllers onto these pads.

Please refer to pinctrl-bindings.txt in this directory for details of the
common pinctrl bindings used by client devices, including the meaning of the
phrase "pin configuration node".


Required properties:
  - compatible: may be "nexell,s5pxx18-pinctrl", "nexell,s5p6818-pinctrl"
  - reg: should be register base and length as documented in the datasheet
  - interrupts: interrupt specifier for the controller over gpio and alive pins

Example:
pinctrl_0: pinctrl@c0010000 {
	compatible = "nexell,s5pxx18-pinctrl";
	#address-cells = <1>;
	#size-cells = <1>;
	reg = <PHYS_BASE_GPIOA 0x1000
	       PHYS_BASE_GPIOB 0x1000
	       PHYS_BASE_GPIOC 0x1000
	       PHYS_BASE_GPIOD 0x1000
	       PHYS_BASE_GPIOE 0x1000
	       PHYS_BASE_ALIVE 0x800>;
	interrupts = <0 IRQ_GPIOA 0>,
		     <0 IRQ_GPIOB 0>,
		     <0 IRQ_GPIOC 0>,
		     <0 IRQ_GPIOD 0>,
		     <0 IRQ_GPIOE 0>,
		     <0 IRQ_ALIVE 0>;
};

  Note: Setting up the order must always match.


Nexell's pin configuration nodes act as a container for an arbitrary number of
subnodes. Each of these subnodes represents some desired configuration for a
pin, a group, or a list of pins or groups. This configuration can include the
mux function to select on those pin(s)/group(s), and various pin configuration
parameters. Values can be changed to macro string, and this is defined in
(include/dt-bindings/pinctrl/nexell.h)

  Child nodes must be set at least one of the following settings:
  - nexell,pins = Select pins for using this function.
  - nexell,pin-function = Select the function for use in a selected pin.
  - nexell,pin-pull = Pull up/down configuration.
  - nexell,pin-strength = Drive strength configuration.
  - nexell,pin-dir = GPIO direction configuration(Input/Output).
  - nexell,pin-val = GPIO value configuration(High/Low).

  Valid values for nexell,pins are:
     "gpioX-N" : X in {A,B,C,D,E}, N in {0-31}
  Valid values for nexell,pin-function are:
     "N"       : N in {0-3}.
                 This setting means that the value is different for each pin.
                 Please refer to datasheet.
		- Value to Macro
			0 - NX_PIN_FUNC0
			1 - NX_PIN_FUNC1
			2 - NX_PIN_FUNC2
			3 - NX_PIN_FUNC3
  Valid values for nexell,pin-pull are:
     "N"       : 0 - Down, 1 - Up, 2 - Off
		- Value to Macro
			0 - NX_PIN_PULL_DOWN
			1 - NX_PIN_PULL_UP
			2 - NX_PIN_PULL_NONE
  Valid values for nexell,pin-strength are:
     "N"       : 0,1,2,3
		- Value to Macro
			0 - NX_PIN_STR0
			1 - NX_PIN_STR1
			2 - NX_PIN_STR2
			3 - NX_PIN_STR3
  Valid value for nexell,pin-dir are:
     "N"       : 0,1
		- Value to Macro
			0 - NX_GPIO_INPUT
			1 - NX_GPIO_OUTPUT
  Valid value for nexell,pin-val are:
     "N"       : 0,1
		- Value to Macro
			0 - NX_GPIO_LOW
			1 - NX_GPIO_HIGH

Example:
  - pin settings
	gmac_txd: gmac-txd {
		nexell,pins = "gpioe-7", "gpioe-8", "gpioe-9", "gpioe-10";
		nexell,pin-function = <NX_PIN_FUNC1>;
		nexell,pin-pull = <NX_PIN_PULL_NONE>;
		nexell,pin-strength = <NX_PIN_STR3>;
	};

	gmac_rxd: gmac-rxd {
		nexell,pins = "gpioe-14", "gpioe-15", "gpioe-16", "gpioe-17";
		nexell,pin-function = <NX_PIN_FUNC1>;
		nexell,pin-pull = <NX_PIN_PULL_NONE>;
		nexell,pin-strength = <NX_PIN_STR3>;
	};

	gmac_txen: gmac-txen {
		nexell,pins = "gpioe-11";
		nexell,pin-function = <NX_PIN_FUNC1>;
		nexell,pin-pull = <NX_PIN_PULL_NONE>;
		nexell,pin-strength = <NX_PIN_STR3>;
	};

  - used by client devices
	gmac0:ethernet@... {
		pinctrl-names = "default";
		pinctrl-0 = <&gmac_txd &gmac_rxd &gmac_txen &gmac_mdc
		             &gmac_mdio &gmac_rxclk &gmac_txclk>;
		...
	};
```

## arch/arm/configs/nxp4330_slt_defconfig
```kconfig
# CONFIG_LOCALVERSION_AUTO is not set
CONFIG_DEFAULT_HOSTNAME=""
CONFIG_FHANDLE=y
CONFIG_NO_HZ=y
CONFIG_HIGH_RES_TIMERS=y
CONFIG_BSD_PROCESS_ACCT=y
CONFIG_BSD_PROCESS_ACCT_V3=y
CONFIG_IKCONFIG=y
CONFIG_CGROUP_DEBUG=y
CONFIG_CGROUP_FREEZER=y
CONFIG_CGROUP_DEVICE=y
CONFIG_CPUSETS=y
CONFIG_CGROUP_CPUACCT=y
CONFIG_MEMCG=y
CONFIG_MEMCG_SWAP=y
CONFIG_MEMCG_KMEM=y
CONFIG_RT_GROUP_SCHED=y
CONFIG_BLK_CGROUP=y
CONFIG_NAMESPACES=y
CONFIG_USER_NS=y
CONFIG_SCHED_AUTOGROUP=y
CONFIG_DEFAULT_USE_ENERGY_AWARE=y
CONFIG_BLK_DEV_INITRD=y
CONFIG_INITRAMFS_SOURCE="../result/rootfs/"
CONFIG_KALLSYMS_ALL=y
CONFIG_EMBEDDED=y
# CONFIG_COMPAT_BRK is not set
CONFIG_SLAB=y
CONFIG_PROFILING=y
CONFIG_JUMP_LABEL=y
CONFIG_MODULES=y
CONFIG_MODULE_UNLOAD=y
# CONFIG_BLK_DEV_BSG is not set
CONFIG_PARTITION_ADVANCED=y
CONFIG_BSD_DISKLABEL=y
CONFIG_SOLARIS_X86_PARTITION=y
# CONFIG_IOSCHED_DEADLINE is not set
CONFIG_CFQ_GROUP_IOSCHED=y
CONFIG_ARCH_S5P4418=y
CONFIG_SECURE_REG_ACCESS=y
CONFIG_CPU_NXP4330=y
CONFIG_ARM_THUMBEE=y
# CONFIG_VDSO is not set
CONFIG_SMP=y
CONFIG_HAVE_ARM_ARCH_TIMER=y
CONFIG_ARM_PSCI=y
CONFIG_PREEMPT=y
CONFIG_HZ_1000=y
CONFIG_AEABI=y
CONFIG_HIGHMEM=y
CONFIG_KSM=y
CONFIG_CMA=y
CONFIG_SECCOMP=y
CONFIG_CMDLINE="console=ttyAMA3,115200n8 rdinit=/init printk.time=1"
CONFIG_CPU_FREQ=y
CONFIG_CPU_FREQ_DEFAULT_GOV_USERSPACE=y
CONFIG_CPU_FREQ_GOV_PERFORMANCE=y
CONFIG_CPU_FREQ_GOV_POWERSAVE=y
CONFIG_CPU_FREQ_GOV_ONDEMAND=y
CONFIG_CPU_FREQ_GOV_INTERACTIVE=y
# CONFIG_ARM_NEXELL_CPUFREQ is not set
CONFIG_CPU_IDLE=y
CONFIG_ARM_NEXELL_CPUIDLE=y
CONFIG_VFP=y
CONFIG_NEON=y
# CONFIG_CORE_DUMP_DEFAULT_ELF_HEADERS is not set
CONFIG_BINFMT_MISC=y
# CONFIG_SUSPEND is not set
CONFIG_NET=y
# CONFIG_WIRELESS is not set
CONFIG_DEVTMPFS=y
CONFIG_DEVTMPFS_MOUNT=y
CONFIG_DMA_CMA=y
CONFIG_CMA_SIZE_MBYTES=256
CONFIG_CMA_ALIGNMENT=4
CONFIG_BLK_DEV_LOOP=y
CONFIG_MEMORY_STATE_TIME=y
CONFIG_NX_SCALER=y
# CONFIG_ARTIK_TRUSTZONE_DRIVER is not set
CONFIG_SCSI=y
CONFIG_BLK_DEV_SD=y
CONFIG_CHR_DEV_SG=y
CONFIG_INPUT_FF_MEMLESS=y
CONFIG_INPUT_EVDEV=y
CONFIG_INPUT_KEYRESET=y
CONFIG_KEYBOARD_GPIO=y
# CONFIG_INPUT_MOUSE is not set
CONFIG_INPUT_JOYSTICK=y
CONFIG_INPUT_TABLET=y
CONFIG_INPUT_TOUCHSCREEN=y
CONFIG_TOUCHSCREEN_TSC2007=y
CONFIG_INPUT_MISC=y
CONFIG_INPUT_KEYCHORD=y
CONFIG_INPUT_UINPUT=y
CONFIG_INPUT_GPIO=y
CONFIG_VT_HW_CONSOLE_BINDING=y
# CONFIG_LEGACY_PTYS is not set
# CONFIG_DEVMEM is not set
# CONFIG_DEVKMEM is not set
CONFIG_SERIAL_AMBA_PL011=y
CONFIG_SERIAL_AMBA_PL011_CONSOLE=y
CONFIG_HW_RANDOM=y
CONFIG_I2C_CHARDEV=y
CONFIG_I2C_MUX=y
CONFIG_I2C_GPIO=y
CONFIG_I2C_NX=y
CONFIG_SPI=y
CONFIG_SPI_PL022=y
CONFIG_SPI_SPIDEV=y
CONFIG_PPS=y
CONFIG_GPIO_SYSFS=y
CONFIG_POWER_SUPPLY=y
CONFIG_POWER_RESET=y
CONFIG_WATCHDOG=y
CONFIG_S3C2410_WATCHDOG=y
CONFIG_REGULATOR=y
CONFIG_REGULATOR_FIXED_VOLTAGE=y
CONFIG_REGULATOR_NXE2000=y
CONFIG_MEDIA_SUPPORT=y
CONFIG_MEDIA_CAMERA_SUPPORT=y
CONFIG_MEDIA_CONTROLLER=y
CONFIG_VIDEO_V4L2_SUBDEV_API=y
CONFIG_V4L_PLATFORM_DRIVERS=y
CONFIG_VIDEO_NEXELL=y
CONFIG_VIDEO_NEXELL_CAPTURE=y
CONFIG_VIDEO_NEXELL_CLIPPER=y
CONFIG_VIDEO_NEXELL_DVB=y
CONFIG_VIDEO_NEXELL_MPEGTS=y
CONFIG_VIDEO_NEXELL_CODEC=y
# CONFIG_MEDIA_SUBDRV_AUTOSELECT is not set
CONFIG_VIDEO_TW9900=y
CONFIG_VIDEO_TW9992=y
CONFIG_VIDEO_ADV7393=y
CONFIG_DVB_AU8522_V4L=y
CONFIG_DVB_TUNER_DIB0070=y
CONFIG_DVB_TUNER_DIB0090=y
CONFIG_DRM=y
CONFIG_DRM_PANEL_SIMPLE=y
CONFIG_DRM_PANEL_S6E8FA0=y
CONFIG_DRM_NX=y
CONFIG_DRM_CHECK_PRE_INIT=y
CONFIG_DRM_NX_LVDS=y
CONFIG_DRM_NX_CLUSTER_LCD=y
# CONFIG_DRM_CHECK_IOCTL_AUTH is not set
# CONFIG_DRM_NX_FB_PAN_DISPLAY is not set
CONFIG_MALI400=y
CONFIG_BACKLIGHT_LCD_SUPPORT=y
# CONFIG_LCD_CLASS_DEVICE is not set
CONFIG_BACKLIGHT_CLASS_DEVICE=y
# CONFIG_BACKLIGHT_GENERIC is not set
CONFIG_BACKLIGHT_PWM=y
CONFIG_LOGO=y
CONFIG_SOUND=y
CONFIG_SND=y
CONFIG_SND_SOC=y
CONFIG_SND_NX_SOC=y
CONFIG_SND_NX_I2S_CH1=y
CONFIG_SND_NX_I2S_CH2=y
CONFIG_SND_SPDIF_TRANSCEIVER=y
CONFIG_SND_SPDIF_RECEIVER=y
CONFIG_SND_CODEC_NULL=y
CONFIG_SND_CODEC_RT5631=y
CONFIG_SND_NX_SIMPLE_CARD=y
CONFIG_HIDRAW=y
CONFIG_UHID=y
CONFIG_HID_A4TECH=y
CONFIG_HID_APPLE=y
CONFIG_HID_BELKIN=y
CONFIG_HID_CHERRY=y
CONFIG_HID_CHICONY=y
CONFIG_HID_CYPRESS=y
CONFIG_HID_EZKEY=y
CONFIG_HID_KENSINGTON=y
CONFIG_HID_LOGITECH=y
CONFIG_HID_MICROSOFT=y
CONFIG_HID_MONTEREY=y
CONFIG_USB=y
CONFIG_USB_ANNOUNCE_NEW_DEVICES=y
CONFIG_USB_DYNAMIC_MINORS=y
CONFIG_USB_EHCI_HCD=y
CONFIG_USB_EHCI_ROOT_HUB_TT=y
CONFIG_USB_EHCI_EXYNOS=y
CONFIG_USB_OHCI_HCD=y
CONFIG_USB_OHCI_EXYNOS=y
CONFIG_USB_STORAGE=y
CONFIG_USB_DWC2=y
CONFIG_USB_GADGET=y
CONFIG_USB_CONFIGFS=m
CONFIG_USB_CONFIGFS_SERIAL=y
CONFIG_USB_CONFIGFS_ACM=y
CONFIG_USB_CONFIGFS_OBEX=y
CONFIG_USB_CONFIGFS_NCM=y
CONFIG_USB_CONFIGFS_ECM=y
CONFIG_USB_CONFIGFS_ECM_SUBSET=y
CONFIG_USB_CONFIGFS_RNDIS=y
CONFIG_USB_CONFIGFS_EEM=y
CONFIG_USB_CONFIGFS_MASS_STORAGE=y
CONFIG_USB_CONFIGFS_F_LB_SS=y
CONFIG_USB_CONFIGFS_F_FS=y
CONFIG_USB_CONFIGFS_F_MTP=y
CONFIG_USB_CONFIGFS_F_PTP=y
CONFIG_USB_CONFIGFS_F_ACC=y
CONFIG_USB_CONFIGFS_F_AUDIO_SRC=y
CONFIG_USB_CONFIGFS_UEVENT=y
CONFIG_USB_CONFIGFS_F_UAC1=y
CONFIG_USB_CONFIGFS_F_UAC2=y
CONFIG_USB_CONFIGFS_F_MIDI=y
CONFIG_USB_CONFIGFS_F_HID=y
CONFIG_USB_CONFIGFS_F_PRINTER=y
CONFIG_MMC=y
CONFIG_MMC_DW=y
CONFIG_MMC_DW_NEXELL=y
CONFIG_RTC_CLASS=y
CONFIG_RTC_DRV_NX=y
CONFIG_DMADEVICES=y
CONFIG_STAGING=y
CONFIG_ASHMEM=y
CONFIG_ANDROID_TIMED_GPIO=y
CONFIG_ANDROID_LOW_MEMORY_KILLER=y
CONFIG_SYNC=y
CONFIG_SW_SYNC=y
CONFIG_SW_SYNC_USER=y
CONFIG_ION=y
CONFIG_ION_NEXELL=y
# CONFIG_IOMMU_SUPPORT is not set
CONFIG_PM_DEVFREQ=y
CONFIG_IIO=y
CONFIG_NX_ADC=y
CONFIG_PWM=y
CONFIG_PWM_SAMSUNG=y
CONFIG_ANDROID=y
CONFIG_ANDROID_BINDER_IPC=y
CONFIG_GATOR=y
CONFIG_SWITCH=y
CONFIG_EXT2_FS=y
CONFIG_EXT4_FS=y
CONFIG_EXT4_FS_POSIX_ACL=y
CONFIG_EXT4_FS_SECURITY=y
# CONFIG_DNOTIFY is not set
CONFIG_QUOTA=y
CONFIG_QUOTA_NETLINK_INTERFACE=y
CONFIG_QFMT_V2=y
CONFIG_AUTOFS4_FS=y
CONFIG_FUSE_FS=y
CONFIG_MSDOS_FS=y
CONFIG_VFAT_FS=y
CONFIG_TMPFS=y
CONFIG_TMPFS_POSIX_ACL=y
CONFIG_CONFIGFS_FS=y
CONFIG_SQUASHFS=y
CONFIG_SQUASHFS_XATTR=y
CONFIG_SQUASHFS_LZ4=y
CONFIG_PSTORE=y
CONFIG_PSTORE_CONSOLE=y
CONFIG_PSTORE_RAM=y
CONFIG_NLS_CODEPAGE_437=y
CONFIG_NLS_ASCII=y
CONFIG_NLS_ISO8859_1=y
CONFIG_PRINTK_TIME=y
CONFIG_DEBUG_INFO=y
CONFIG_FRAME_WARN=2048
CONFIG_MAGIC_SYSRQ=y
CONFIG_LOCKUP_DETECTOR=y
CONFIG_PANIC_ON_OOPS=y
CONFIG_PANIC_TIMEOUT=5
# CONFIG_SCHED_DEBUG is not set
CONFIG_SCHEDSTATS=y
CONFIG_TIMER_STATS=y
CONFIG_FUNCTION_TRACER=y
CONFIG_IRQSOFF_TRACER=y
CONFIG_PREEMPT_TRACER=y
CONFIG_SCHED_TRACER=y
CONFIG_FTRACE_SYSCALLS=y
CONFIG_BLK_DEV_IO_TRACE=y
CONFIG_FUNCTION_PROFILER=y
CONFIG_DEBUG_USER=y
CONFIG_KEYS=y
CONFIG_SECURITY=y
CONFIG_SECURITY_NETWORK=y
CONFIG_CRYPTO_CRYPTD=y
CONFIG_CRYPTO_AUTHENC=y
CONFIG_CRYPTO_CCM=y
CONFIG_CRYPTO_GCM=y
CONFIG_CRYPTO_ECHAINIV=y
CONFIG_CRYPTO_CBC=y
CONFIG_CRYPTO_ECB=y
CONFIG_CRYPTO_CMAC=y
CONFIG_CRYPTO_MD5=y
CONFIG_CRYPTO_SHA1=y
CONFIG_CRYPTO_AES=y
CONFIG_CRYPTO_ARC4=y
CONFIG_CRYPTO_DES=y
CONFIG_CRYPTO_TWOFISH=y
CONFIG_CRYPTO_DEFLATE=y
CONFIG_CRYPTO_LZO=y
# CONFIG_CRYPTO_HW is not set
CONFIG_CRC_CCITT=y
CONFIG_LIBCRC32C=y
```

## drivers/input/touchscreen/semisens/Kconfig
```kconfig
#
# Semisens Touchscreen driver configuration
#
config TOUCHSCREEN_SEMISENS
	tristate "SEMISENS I2C Touchscreen"
	depends on I2C
	help
		Say Y here if you have Semisens I2C touchscreen,
		such as SNXXXMQ, connected to your system.
		If unsure, say N.
		To compile this driver as a module, choose M here:
		the module will be called SEMISENS.
```

## drivers/media/i2c/maxim/Kconfig
```kconfig
#
# MAX9286 device configuration
#

config VIDEO_MAX9286
    bool "MAX9286 video decoder(nexell work)"
    depends on I2C && VIDEO_V4L2
    help
	  Support for the Maxim MAX9286 video decoder.

choice
	prompt "MAXIM GMSL Serializer type" if VIDEO_MAX9286
	default VIDEO_MAX9286_MAX9271

config VIDEO_MAX9286_MAX9271
	bool "Use max9271 and sony ISX016 senor if available"
	help
	  max9286 - max9271 - sony ISX016 sensor

config VIDEO_MAX9286_MAX96705
	bool "Use max96705 and atina ar0140at senor if available"
	help
	  max9286 - max96705 - atina ar0140at sensor
endchoice

config VIDEO_MAX9286_MCU
	bool "Use MCU chip initialize"
	depends on VIDEO_MAX9286
	help
	  Support for proceed to setting the MAX9286 register on the MCU.

config MAX9286_BACKWARD
	bool "backward camera"
	depends on SLSIAP_BACKWARD_CAMERA
	help
	  This set as backward camera
```

## drivers/media/platform/nexell/capture/Kconfig
```kconfig
config VIDEO_NEXELL_CLIPPER
	bool "Enable capture clipper video device"
	default n
	---help---
	  Say y here to enable Nexell S5Pxx18 series VIP clipper video device.
	  Clipper video device can crop source crop and has memory interface.
	  If you want to enable only clipper subdev, don't check this.

config CLIPPER_USE_DQTIMER
	bool "Enable clipper dequeue timeout timer"
	depends on VIDEO_NEXELL_CLIPPER
	---help---
	  Say y here to enable clipper dequeue timer to prevent infinite blocking
	  of user application.

config CLIPPER_DQTIMER_TIMEOUT
	int "Clipper DQTimer Timeout Millisecond"
	depends on CLIPPER_USE_DQTIMER
	default 200
	---help---
	  Specify timeout value by millisecond unit.

config VIDEO_NEXELL_DECIMATOR
	bool "Enable capture decimator video device"
	default n
	---help---
	  Say y here to enable Nexell S5Pxx18 series VIP decimator video device.
	  Decimator video device can scale down and has memory interface.

config DECIMATOR_USE_DQTIMER
	bool "Enable decimator dequeue timeout timer"
	depends on VIDEO_NEXELL_DECIMATOR
	---help---
	  Say y here to enable decimator dequeue timer to prevent infinite blocking
	  of user application.

config DECIMATOR_DQTIMER_TIMEOUT
	int "Decimator DQTimer Timeout Millisecond"
	depends on DECIMATOR_USE_DQTIMER
	default 200
	---help---
	  Specify timeout value by millisecond unit.

config VIDEO_NEXELL_REARCAM
	bool "Enable fast preview of rear camera device"
	depends on !V4L2_INIT_LEVEL_UP
	default n
	---help---
	  Say y here, you cna view cmaera as soon as kernel booting, and this
	  driver switch on/off camera by gpio interrupt.

if VIDEO_NEXELL_REARCAM

config VIDEO_NEXELL_REARCAM_SAMPLEPARKINGLINE
	bool "Drawing sample parking assist line with raw data"
	default n
	---help---
	  Say y here to draw a parking assist line using the raw data provided
	  by the sample when drawing the parking assist in the rear camera.

config VIDEO_NEXELL_REARCAM_VENDOR_FMS
	bool "Nexell Rearcam Vendor FMS Driver"
	default n
	---help---
	  Say y here to support a rearcam vendor driver for FMS

endif # VIDEO_NEXELL_REARCAM
```

## drivers/media/platform/nexell/m2m/Kconfig
```kconfig
config VIDEO_NEXELL_DEINTERLACER
	bool "Enable deinterlacer"
	depends on ARCH_S5P6818 && VIDEO_NEXELL_M2M
	default n
	help
	  This is a deinterlace driver for Nexell Soc. The deinterlace
	  block makes a frame data by using a field(Odd/Even) data.
	  If the current field of the iamge is an even field, the creates
	  a new odd field by using the previous odd field
	  and the next odd field.

	  Say y here to enable deinterlacer
```
