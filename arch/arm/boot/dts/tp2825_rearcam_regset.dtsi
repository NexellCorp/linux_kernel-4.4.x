/*
 * Copyright (C) 2016  Nexell Co., Ltd.
 * Author: Jongkeun, Choi <jkchoi@nexell.co.kr>
 *
 * This program is free software; you can redistribute it and/or
 * modify it under the terms of the GNU General Public License
 * as published by the Free Software Foundation; either version 2
 * of the License, or (at your option) any later version.
 *
 * This program is distributed in the hope that it will be useful,
 * but WITHOUT ANY WARRANTY; without even the implied warranty of
 * MERCHANTABILITY or FITNESS FOR A PARTICULAR PURPOSE.  See the
 * GNU General Public License for more details.
 *
 * You should have received a copy of the GNU General Public License
 * along with this program.  If not, see <http://www.gnu.org/licenses/>.
 */

/ {
	/* NTSC 720 480 I */
	sensor_tp2825:register {
		/* video */
		data =  <0x40 0x00>,
			<0x07 0xc0>,
			<0x0b 0xc0>,
			<0x39 0x8c>,
			<0x4d 0x03>,
			<0x4e 0x17>,
			/* PTZ */
			<0xc8 0x21>,
			<0x7e 0x01>,
			<0xb9 0x01>,
			/* Data Set */
			<0x4e 0x17>,
			<0x02 0xcf>,
			<0x15 0x13>,
			<0x16 0x4e>,
			<0x17 0x80>,
			<0x18 0x13>,
			<0x19 0xf0>,
			<0x1a 0x07>,
			<0x1c 0x09>,
			<0x1d 0x38>,

			<0x0c 0x53>,
			<0x0d 0x10>,
			<0x20 0xa0>,
			<0x26 0x12>,
			<0x2b 0x70>,
			<0x2d 0x68>,
			<0x2e 0x5e>,

			<0x30 0x62>,
			<0x31 0xbb>,
			<0x32 0x96>,
			<0x33 0xc0>,
			<0x35 0x25>,
			<0x39 0x84>;
	};

	/* NTSC : 1920x480 I */
	tp2825_ntsc_1920x480i:register {
		/* video */
		data =  <0x40 0x00>,
			<0x07 0xc0>,
			<0x0b 0xc0>,
			<0x39 0x8c>,
			<0x4d 0x03>,
			<0x4e 0x17>,
			/* PTZ */
			<0xc8 0x21>,
			<0x7e 0x01>,
			<0xb9 0x01>,
			/* Data Set */
			<0x4e 0x17>,
			<0x02 0xcf>,
			<0x15 0x13>,
			<0x16 0x4e>,
			<0x17 0x80>,
			<0x18 0x13>,
			<0x19 0xf0>,
			<0x1a 0x07>,
			<0x1c 0x09>,
			<0x1d 0x38>,
			<0x0c 0x53>,
			<0x0d 0x10>,
			<0x20 0xa0>,
			<0x26 0x12>,
			<0x2b 0x70>,
			<0x2d 0x68>,
			<0x2e 0x5e>,
			<0x30 0x62>,
			<0x31 0xbb>,
			<0x32 0x96>,
			<0x33 0xc0>,
			<0x35 0x25>,
			<0x39 0x84>;
	};

	/* PAL : 1920x576 I */
	tp2825_pal_1920x576i:register {
		/* video */
		data =  <0x40 0x00>,
			<0x07 0xc0>,
			<0x0b 0xc0>,
			<0x39 0x8c>,
			<0x4d 0x03>,
			<0x4e 0x17>,
			/* PTZ */
			<0xc8 0x21>,
			<0x7e 0x01>,
			<0xb9 0x01>,
			/* Data Set */
			<0x4e 0x17>,
			<0x02 0xcf>,
			<0x15 0x13>,
			<0x16 0x68>,
			<0x17 0x80>,
			<0x18 0x17>,
			<0x19 0x20>,
			<0x1a 0x17>,
			<0x1c 0x09>,
			<0x1d 0x48>,
			<0x0c 0x53>,
			<0x0d 0x11>,
			<0x20 0xb0>,
			<0x26 0x02>,
			<0x2b 0x70>,
			<0x2d 0x60>,
			<0x2e 0x5e>,
			<0x30 0x7a>,
			<0x31 0x4a>,
			<0x32 0x4d>,
			<0x33 0xf0>,
			<0x35 0x25>,
			<0x39 0x84>;
	};
};
